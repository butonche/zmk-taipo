## config/boards/shields/custom-22/Kconfig.defconfig
```kconfig
config ZMK_BLE
    default y

config ZMK_USB
    default y

config ZMK_SPLIT
    default y

if SHIELD_CUSTOM_22_DONGLE 

config ZMK_KEYBOARD_NAME
    default "Custom 22"

config ZMK_SPLIT_BLE_ROLE_CENTRAL
    default y

if LVGL
    
config LV_Z_VDB_SIZE
    default 64

config LV_Z_DPI
    default 148

config LV_Z_BITS_PER_PIXEL
    default 1

choice LV_COLOR_DEPTH
    default LV_COLOR_DEPTH_1
endchoice

endif # LVGL

endif

if SHIELD_CUSTOM_22_LEFT || SHIELD_CUSTOM_22_RIGHT

config ZMK_SLEEP
    default y
    
endif
```

## config/boards/shields/custom-22/Kconfig.shield
```kconfig
# Copyright (c) 2020 The ZMK Contributors
# SPDX-License-Identifier: MIT

config SHIELD_CUSTOM_22_LEFT
	def_bool $(shields_list_contains,custom_22_left)

config SHIELD_CUSTOM_22_RIGHT
	def_bool $(shields_list_contains,custom_22_right)

config SHIELD_CUSTOM_22_DONGLE
	def_bool $(shields_list_contains,custom_22_dongle)
```

## config/west.yml
```yaml
manifest:
  remotes:
    - name: zmkfirmware
      url-base: https://github.com/zmkfirmware
    - name: butonche
      url-base: https://github.com/butonche
   - name: englmaxi
      url-base: https://github.com/englmaxi
  projects:
    - name: zmk
      remote: zmkfirmware
      revision: v0.3
      import: app/west.yml
    - name: zmk-shield-custom-22
      remote: butonche
      revision: main
    - name: zmk-feature-rolling-combos
      remote: butonche
      revision: main
    - name: zmk-dongle-display
      remote: englmaxi
      revision: v0.3
  self:
    path: config
```
